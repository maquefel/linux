## Documentation/devicetree/bindings/arm/ep93xx.yaml
```yaml
# SPDX-License-Identifier: GPL-2.0-only OR BSD-2-Clause
%YAML 1.2
---
$id: http://devicetree.org/schemas/arm/ep93xx.yaml#
$schema: http://devicetree.org/meta-schemas/core.yaml#

title: Cirrus Logick EP93xx device tree bindings

maintainers:
  - Nikita Shubin <nikita.shubin@maquefel.me>

description: |+
  The EP93xx SoC is a ARMv4T-based with 200 MHz ARM9 CPU.

properties:
  $nodename:
    const: '/'
  compatible:
    const: cirrus,ep93xx

  soc:
    type: object
    properties:
      compatible:
        const: syscon

      syscon:
        type: object
        properties:
          compatible:
            items:
              - const: cirrus,ep93xx-syscon
              - const: syscon
              - const: simple-mfd
        required:
          - compatible
          - reg
          - '#clock-cells'

      timer:
        type: object

    required:
      - compatible
      - syscon
      - timer

required:
  - compatible
  - soc

additionalProperties: true

examples:
  - |
    #include <dt-bindings/clock/cirrus,ep93xx-clock.h>
    / {
      compatible = "cirrus,ep93xx";

    soc {
      #address-cells = <1>;
      #size-cells = <1>;
      ranges;
      compatible = "simple-bus";

      syscon: syscon@80930000 {
        compatible = "cirrus,ep93xx-syscon",
        "syscon", "simple-mfd";
        reg = <0x80930000 0x1000>;
        #clock-cells = <1>;
        #reset-cells = <1>;

        ep93xx-reboot {
          compatible = "cirrus,ep93xx-reboot";
        };

        timer@80810000 {
          compatible = "cirrus,ep93xx-timer";
          reg = <0x80810000 0x100>;
          interrupt-parent = <&vic1>;
          interrupts = <19>;
        };
    };

...
```

## Documentation/devicetree/bindings/gpio/gpio-ep93xx.yaml
```yaml
# SPDX-License-Identifier: (GPL-2.0 OR BSD-2-Clause)
%YAML 1.2
---
$id: http://devicetree.org/schemas/gpio/gpio-ep93xx.yaml#
$schema: http://devicetree.org/meta-schemas/core.yaml#

title: EP93xx GPIO controller

maintainers:
  - Nikita Shubin <nikita.shubin@maquefel.me>

properties:
  compatible:
    const: cirrus,ep93xx-gpio

  chip-label:
    maxItems: 1
    description: human readable name.
    
  reg:
    minItems: 2
    maxItems: 3
    items:
      - description: data register
      - description: direction register
      - description: interrupt registers base

  reg-names:
    minItems: 2
    maxItems: 3
    items:
      - const: data
      - const: dir
      - const: intr

  gpio-controller: true

  "#gpio-cells":
    const: 2

  interrupt-controller: true

  "#interrupt-cells":
    const: 2

  interrupts:
    items:
      - const: 27
   
  interrupts-extended:
    items:
      - const: '&vic0 19'
      - const: '&vic0 20'
      - const: '&vic0 21'
      - const: '&vic0 22'
      - const: '&vic1 15'
      - const: '&vic1 16'
      - const: '&vic1 17'
      - const: '&vic1 18'
    description: port F has dedicated irq line for each gpio line.

required:
  - compatible
  - reg
  - gpio-controller
  - "#gpio-cells"

additionalProperties: false

...
```

## Documentation/devicetree/bindings/pwm/cirrus,ep93xx-pwm.yaml
```yaml
# SPDX-License-Identifier: GPL-2.0
%YAML 1.2
---
$id: http://devicetree.org/schemas/pwm/cirrus,ep93xx-pwm.yaml#
$schema: http://devicetree.org/meta-schemas/core.yaml#

title: Cirrus Logick ep93xx PWM controller

maintainers:
  - Nikita Shubin <nikita.shubin@maquefel.me>

properties:
  compatible:
    enum:
      - cirrus,ep93xx-pwm
  reg:
    maxItems: 1

  clocks:
    items:
      - description: SoC PWM clock

  clock-names:
    items:
      - const: pwm_clk

required:
  - compatible
  - reg
  - clocks
  - clock-names

additionalProperties: false

examples:
  - |
    pwm0: pwm@80910000 {
        compatible = "cirrus,ep93xx-pwm";
        reg = <0x80910000 0x10>;
        clocks = <&syscon EP93XX_CLK_PWM>;
        clock-names = "pwm_clk";
    };

...
```

## Documentation/devicetree/bindings/rtc/cirrus,ep93xx-rtc.yaml
```yaml
# SPDX-License-Identifier: (GPL-2.0-only OR BSD-2-Clause)
%YAML 1.2
---
$id: http://devicetree.org/schemas/rtc/ep93xx-rtc.yaml#
$schema: http://devicetree.org/meta-schemas/core.yaml#

title: Cirrus EP93xx Real Time Clock controller

maintainers:
  - Hartley Sweeten <hsweeten@visionengravers.com>
  - Alexander Sverdlin <alexander.sverdlin@gmail.com>

properties:
  compatible:
    const: cirrus,ep93xx-rtc

  reg:
    maxItems: 1

required:
  - compatible
  - reg

additionalProperties: false

examples:
  - |
    rtc0: rtc@80920000 {
        compatible = "cirrus,ep93xx-rtc";
        reg = <0x80920000 0x100>;
    };
```

## Documentation/devicetree/bindings/spi/spi-ep93xx.yaml
```yaml
# SPDX-License-Identifier: GPL-2.0
%YAML 1.2
---
$id: http://devicetree.org/schemas/spi/spi-ep93xx.yaml#
$schema: http://devicetree.org/meta-schemas/core.yaml#

title: EP93xx SoC SPI controller

maintainers:
  - Nikita Shubin <nikita.shubin@maquefel.me>

allOf:
  - $ref: "spi-controller.yaml#"

properties:
  compatible:
    items:
      - const: cirrus,ep93xx-spi

  reg:
    items:
      - description: SPI registers region

  interrupts:
    maxItems: 1

  clocks:
    maxItems: 1

required:
  - compatible
  - reg
  - interrupts
  - clocks

unevaluatedProperties: false

...
```

## Documentation/devicetree/bindings/timer/cirrus,ep93xx-timer.yaml
```yaml
# SPDX-License-Identifier: (GPL-2.0-only OR BSD-2-Clause)
%YAML 1.2
---
$id: http://devicetree.org/schemas/timer/cirrus,ep93xx-timer.yaml#
$schema: http://devicetree.org/meta-schemas/core.yaml#

title: Cirrus Logic EP93xx timers bindings

maintainers:
  - Nikita Shubin <nikita.shubin@maquefel.me>

properties:
  compatible:
    const: cirrus,ep93xx-timer

  reg:
    maxItems: 1

  interrupt-parent:
    maxItems: 1

  interrupts:
    maxItems: 1

  clocks:
    maxItems: 1

  resets:
    maxItems: 1

required:
  - compatible
  - reg
  - interrupt-parent
  - interrupts
  - clocks

additionalProperties: false

examples:
  - |
    timer@80810000 {
        compatible = "cirrus,ep93xx-timer";
        reg = <0x80810000 0x100>;
        interrupt-parent = <&vic1>;
        interrupts = <19>;
    };
...
```

## Documentation/devicetree/bindings/watchdog/cirrus,ep93xx-wdt.yaml
```yaml
# SPDX-License-Identifier: (GPL-2.0-only OR BSD-2-Clause)
%YAML 1.2
---
$id: http://devicetree.org/schemas/watchdog/cirrus,ep93xx-wdt.yaml#
$schema: http://devicetree.org/meta-schemas/core.yaml#

title: Cirrus Logic EP93xx Watchdog Timer

maintainers:
  - Nikita Shubin <nikita.shubin@maquefel.me>

description:
  Watchdog driver for Cirrus Logic EP93xx family of devices.

allOf:
  - $ref: "watchdog.yaml#"

properties:
  compatible:
    enum:
      - cirrus,ep93xx-wdt

  reg:
    maxItems: 1

required:
  - compatible
  - reg

examples:
  - |
    wdt0: wdt@0x80940000 {
        compatible = "cirrus,ep93xx-wdt";
        reg = <0x80940000 0x08>;
    };
```
